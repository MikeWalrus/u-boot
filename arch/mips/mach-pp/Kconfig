## arch/mips/mach-pp/Kconfig
```kconfig
menu "PP platforms"
  depends on TARGET_PP

choice
  prompt "PP SoC select"

config SOC_UP_PP
  bool "soc_up from nscscc2022_group_v0.01"

endchoice

source "board/pp/soc_up/Kconfig"

endmenu
```

## board/pp/soc_up/Kconfig
```kconfig
if SOC_UP_PP

config SYS_BOARD
  default "soc_up"

config SYS_CONFIG_NAME
  default "soc_up"

config SYS_VENDOR
  default "pp"

config SYS_TEXT_BASE
  default 0xbfc00000

config SYS_LOAD_ADDR
  default 0xbfc00000

config SYS_MONITOR_BASE
  default 0xbfc00000

config DEFAULT_DEVICE_TREE
  string
  default "soc_up"

endif
```

## configs/soc_up_pp_defconfig
```kconfig
CONFIG_MIPS=y
CONFIG_TARGET_PP=y
CONFIG_LOGLEVEL=9
CONFIG_VPL_LOGLEVEL=4
CONFIG_OF_EMBED=y
```
